## CMakeLists.txt
```
cmake_minimum_required(VERSION 3.20.0)

if(NOT BOARD)
    set(BOARD damiao_mc02)
endif()

# clangd reads the actual Zephyr compiler flags and generated include paths.
set(CMAKE_EXPORT_COMPILE_COMMANDS ON)
find_package(Zephyr REQUIRED HINTS $ENV{ZEPHYR_BASE})
project(infantry_dog LANGUAGES C CXX ASM)

target_include_directories(app PRIVATE ${CMAKE_CURRENT_SOURCE_DIR}/inc)

# Record libstdc++ paths explicitly for clangd 14's standalone header parsing.
# Ask the selected compiler so these paths follow the installed toolchain.
execute_process(
    COMMAND ${CMAKE_CXX_COMPILER} -E -x c++ -v -
    INPUT_FILE /dev/null
    OUTPUT_QUIET
    ERROR_VARIABLE compiler_include_search
    COMMAND_ERROR_IS_FATAL ANY
)
string(REPLACE "\n" ";" compiler_include_search "${compiler_include_search}")
foreach(include_dir IN LISTS compiler_include_search)
    string(STRIP "${include_dir}" include_dir)
    if(IS_DIRECTORY "${include_dir}" AND include_dir MATCHES "/include/c\\+\\+/")
        target_compile_options(app PRIVATE "$<$<COMPILE_LANGUAGE:CXX>:-isystem${include_dir}>")
    endif()
endforeach()

target_sources(app PRIVATE
    src/main.cpp
    src/chassis_mec.cpp
    src/chassis_remote.cpp
)

if(CONFIG_ALGO)
    target_link_libraries(app PRIVATE robotpilots::algorithm)
endif()
```

## prj.conf
```kconfig
CONFIG_CPP=y
CONFIG_STD_CPP20=y
CONFIG_RAMENX=y
CONFIG_GLIBCXX_LIBCPP=y
CONFIG_REQUIRES_FULL_LIBCPP=y
CONFIG_THREAD_NAME=y

CONFIG_BREEZE=y
CONFIG_PRINTK=y

CONFIG_CONSOLE=y
CONFIG_RTT_CONSOLE=y
CONFIG_UART_CONSOLE=n

CONFIG_LOG=y
CONFIG_LOG_PROCESS_THREAD_STACK_SIZE=4096
CONFIG_LOG_BACKEND_RTT=y
CONFIG_LOG_BACKEND_UART=n

# 保留基本优化但便于调试（ 如果不配置这一条可能导致代码被优化掉，断点无效 ）
CONFIG_DEBUG_OPTIMIZATIONS=y

# RTT->VOFA+ 配置
CONFIG_USE_SEGGER_RTT=y
# 5个上行通道 2个下行通道
CONFIG_SEGGER_RTT_MAX_NUM_UP_BUFFERS=5
CONFIG_SEGGER_RTT_MAX_NUM_DOWN_BUFFERS=2

CONFIG_ALGO=y

# DT7 remote driver: the application assembles and parses received frames.
CONFIG_SERIAL=y
CONFIG_UART_STM32=n
CONFIG_RP_UART_STM32=y
CONFIG_UART_ASYNC_API=y
CONFIG_REMOTE=y
CONFIG_REMOTE_PROTOCOL_DT7=y

# The remote DMA buffers are not maintained for the Cortex-M7 data cache.
CONFIG_DCACHE=n
```

## src/main.cpp
```c
// Application entry point. Hardware control is not started by this scaffold.
int main()
{
	return 0;
}
```

## inc/chassis.hpp
```c
/**
 * @file chassis.hpp
 * @author River-zzZ (silver250928@outlook.com)
 * @brief 底盘模块相关配置定义
 * @version 0.1.0
 * @date 2026-11-24
 *
 * @copyright Copyright (c) 2026 RobotPilots-SZU
 *
 */
#pragma once

#include <cstdint>

namespace breeze::chassis
{

class Config
{
public:
	/**
	 * @brief 底盘各种电机数量
	 *
	 */
	struct MotorNumber
	{
		std::uint8_t Wheel;
		std::uint8_t Steering;
		std::uint8_t Joint;
	};

	/**
	 * @brief 小陀螺动作信息结构体
	 *
	 */
	struct Cycle
	{
		float Target;   // 小陀螺目标速度 m/s（逆时针为正）
		float MaxSpeed; // 小陀螺最大速度
	};
};



class Control
{
public:
	/**
	 * @brief 底盘控制模式
	 *
	 */
	enum class Mode : std::uint8_t
	{
		Uknown = 0,

		Sleep,      // 卸力
		Mechanical, // 机械模式
		Gyro,       // 陀螺仪模式
		Cycle,      // 小陀螺
	};

	/**
	 * @brief 底盘运动目标
	 *
	 */
	struct Target
	{
		float Vx;    // x方向速度（向右为正）
		float Vy;    // y方向速度（向前为正）
		float Cycle; // 小陀螺旋转速度（逆时针为正）
	};
};



class Output
{
	/**
	 * @brief 当前速度
	 *
	 */
	struct CurrentSpeed
	{
		float Vx;    // X方向
		float Vy;    // Y方向
		float Cycle; // 小陀螺旋转速度
	};
};


} // namespace breeze::chassis
```

## inc/chassis_mec.hpp
```c
/**
 * @file chassis_mec.hpp
 * @author River-zzZ (silver250928@outlook.com)
 * @brief 全向轮底盘模块相关配置定义
 * @version 0.1.0
 * @date 2026-11-24
 *
 * @copyright Copyright (c) 2026 RobotPilots-SZU
 *
 */
#pragma once

#include "chassis.hpp"
#include "motor.hpp"
#include <array>
#include <cstdint>

namespace breeze::chassis::mec
{

/**
 * @brief 全向轮底盘电机位置
 *
 */
enum class MotorPosition : std::uint8_t
{
	Unknown = 0,

	LeftFront,   // 左前
	LeftBehind,  // 左后
	RightFront,  // 右前
	RightBehind, // 右后
};

/**
 * @brief 全向轮底盘的电机信息
 *
 */
struct MotorConfig
{
	MotorPosition Position;                    // 位置
	breeze::chassis::motor::Role::Wheel Motor; // 电机信息
};

/**
 * @brief 电机力矩
 *
 */
struct MotorTorque
{
	float Torque;
};

/**
 * @brief 底盘电机输出
 *
 */
struct MotorOutput
{
	MotorPosition Position;
	MotorTorque Torque;
};

/**
 * @brief 传入电机配置信息
 *
 * @param motor 电机配置信息
 */
void SetMotorConfig(std::array<MotorConfig, 4> motor);

/**
 * @brief 全向轮解算
 *
 * @param target 目标值
 */
std::array<MotorOutput, 4> Solve(breeze::chassis::Control::Target& target);

} // namespace breeze::chassis::mec
```

## inc/chassis_pid.hpp
```c
/**
 * @file pid.hpp
 * @author River-zzZ (silver250928@outlook.com)
 * @brief 底盘电机pid模板
 * @version 0.1
 * @date 2026-10-30
 *
 * @copyright Copyright (c) 2026 RobotPilots-SZU
 *
 */
#pragma once

namespace breeze::chassis::pid
{

/**
 * @brief pid配置
 * @note 这是一个没有完善的结构体
 *
 */
struct Config
{
	float Kp; // 比例系数
	float Ki; // 积分系数
	float Kd; // 微分系数

	float InputDeadband;      // 输入死区
	float MaxOutput;          // 最大输出
	float MaxIntegral;        // 最大积分
	float IntegralSeparation; // 积分分离值
};

} // namespace breeze::chassis::pid
```

## inc/chassis_remote.hpp
```c
/**
 * @file chassis_remote.hpp
 * @author River-zzZ (silver250928@outlook.com)
 * @brief 读取遥控器数据并转换
 * @version 0.2.0
 * @date 2026-11-27
 *
 * @copyright Copyright (c) 2026 RobotPilots-SZU
 *
 */
#pragma once

#include "chassis.hpp"
#include <drivers/remote/remote.h>

namespace breeze::chassis::remote
{

/**
 * @brief 每收一帧回调一次，运行在遥控器接收线程上下文
 *
 */
using FrameCallback = void (*)(const rc_sensor_t* sensor, void* userData);

/**
 * @brief 注册遥控器并开始接收
 *
 * @param callback 每帧解析完后调用，可为空（只想轮询 sensor->info 时）
 * @param userData 透传给 callback
 * @return sensor 指针；失败返回 nullptr
 */
const rc_sensor_t* Init(FrameCallback callback = nullptr, void* userData = nullptr);

/**
 * @brief 遥控器通道转底盘目标速度
 *
 * @note ch0（右摇杆左右）转 Vx，ch1（右摇杆前后）转 Vy
 *
 * @param info 遥控器数据
 * @return 底盘目标速度
 */
Control::Target TargetFrom(const rc_sensor_info_t& info);

} // namespace breeze::chassis::remote
```

## inc/motor.hpp
```c
/**
 * @file motor.hpp
 * @author River-zzZ (silver250928@outlook.com)
 * @brief 底盘模块电机相关配置定义
 * @version 0.1.0
 * @date 2026-11-24
 *
 * @copyright Copyright (c) 2026 RobotPilots-SZU
 *
 */
#pragma once

#include "chassis_pid.hpp"
#include <cstdint>

namespace breeze::chassis::motor
{

/**
 * @brief 电机转动正方向
 *
 */
enum class Direction : std::int8_t
{
	Unknown = 0,

	Clockwise = -1,       // 顺时针
	CounterClockwise = 1, // 逆时针
};

/**
 * @brief 电机作用类型
 *
 */
class Role
{
public:
	/**
	 * @brief 轮毂电机
	 *
	 */
	struct Wheel
	{
		breeze::chassis::motor::Direction Direction; // 电机转动正方向
		breeze::chassis::pid::Config MecPid;         // 机械模式pid参数
		breeze::chassis::pid::Config ImuPid;         // 陀螺仪模式pid参数
	};

	/**
	 * @brief 舵向电机
	 *
	 */
	struct Steering
	{
		breeze::chassis::motor::Direction Direction; // 电机转动正方向
		// 速度环
		breeze::chassis::pid::Config SpeedMecPid; // 速度环机械模式pid参数
		breeze::chassis::pid::Config SpeedImuPid; // 速度环陀螺仪模式pid参数
		// 角度环
		breeze::chassis::pid::Config AngleMecPid; // 角度环机械模式pid参数
		breeze::chassis::pid::Config AngleImuPid; // 角度环陀螺仪模式pid参数
	};

	/**
	 * @brief 关节电机
	 *
	 */
	struct Joint
	{
		breeze::chassis::motor::Direction Direction; // 电机转动正方向
		// 速度环
		breeze::chassis::pid::Config SpeedMecPid; // 速度环机械模式pid参数
		breeze::chassis::pid::Config SpeedImuPid; // 速度环陀螺仪模式pid参数
		// 角度环
		breeze::chassis::pid::Config AngleMecPid; // 角度环机械模式pid参数
		breeze::chassis::pid::Config AngleImuPid; // 角度环陀螺仪模式pid参数
	};
};


} // namespace breeze::chassis::motor
```

## src/chassis_mec.cpp
```c
#include "chassis_mec.hpp"

namespace breeze::chassis::mec
{
namespace
{
// 电机信息存储
std::array<MotorConfig, 4> InternalMotorConfig{};

} // namespace
/**
 * @brief 限速
 *
 */
// static void SpeedLimit(breeze::chassis::Control::Target& target, float maxspeed)
// {
// 	float vx = target.Vx;
// 	float vy = target.Vy;
// 	float cycle = target.Cycle;
// }

/**
 * @brief 全向轮解算
 *
 * @param target 目标值
 */
std::array<MotorOutput, 4> Solve(breeze::chassis::Control::Target& target)
{
	// 输出信息
	std::array<MotorOutput, 4> output{};

	float vx = target.Vx;
	float vy = target.Vy;
	float cycle = target.Cycle;

	output = std::array<MotorOutput, 4>{{
	    {
	        MotorPosition::LeftFront,
	        MotorTorque{-vx + vy - cycle},
	    },
	    {
	        MotorPosition::LeftBehind,
	        MotorTorque{vx + vy - cycle},
	    },
	    {
	        MotorPosition::RightBehind,
	        MotorTorque{-vx + vy + cycle},
	    },
	    {
	        MotorPosition::RightFront,
	        MotorTorque{vx + vy + cycle},
	    },
	}};

	return output;
}

// 貌似是滚木，先放着吧
// 全向轮底盘各种电机数量
breeze::chassis::Config::MotorNumber Omni{
    .Wheel = 4,
    .Steering = 0,
    .Joint = 0,
};

// 设置电机信息
void SetMotorConfig(std::array<MotorConfig, 4> motor)
{
	// 存入InternalMotorConfig
	InternalMotorConfig = motor;
}

} // namespace breeze::chassis::mec
```

## src/chassis_remote.cpp
```c
#include "chassis_remote.hpp"

#include <array>
#include <cstddef>
#include <cstdint>

#include <zephyr/devicetree.h>
#include <zephyr/kernel.h>
#include <zephyr/logging/log.h>

LOG_MODULE_REGISTER(chassis_remote, LOG_LEVEL_INF);

namespace breeze::chassis::remote
{
namespace
{
constexpr std::size_t FRAME_SIZE = 18;       // DT7/DBUS 一帧 18 字节
constexpr std::uint32_t FRAME_GAP_MS = 5;    // 帧间空闲超过 5ms 即认为新帧开始
constexpr std::size_t FRAME_QUEUE_DEPTH = 4; // 14ms 一帧，4 个槽够线程从容处理
constexpr std::size_t THREAD_STACK_SIZE = 1024;
constexpr std::uint8_t THREAD_PRIO = 7;
constexpr float CHANNEL_MAX = 660.0F; // 通道满量程 ±660
constexpr float MAX_VX_SPEED = 40.0F;
constexpr float MAX_VY_SPEED = 40.0F;

const struct device* remoteDevice;
const rc_sensor_t* sensorPointer;
const rc_parser_ops_t* parserOps;
FrameCallback frameCallback;
void* frameCallbackData;

// 拼帧状态，仅中断使用
std::array<std::uint8_t, FRAME_SIZE> rxFrame{};
std::size_t rxFrameLength;
std::uint32_t lastRxTimestamp;

// 拼好的整帧交给线程解析
K_MSGQ_DEFINE(rxFrameQueue, FRAME_SIZE, FRAME_QUEUE_DEPTH, 1);
K_THREAD_STACK_DEFINE(rxThreadStack, THREAD_STACK_SIZE);
struct k_thread rxThread;

/**
 * @brief 取 DT7 设备
 *
 * @note devicetree 里没有 remote_dt7 节点时（例如 native_sim）返回空
 *
 * @return 设备指针；没有节点返回 nullptr
 */
const struct device* ResolveDevice()
{
#if DT_NODE_EXISTS(DT_NODELABEL(remote_dt7))
	return DEVICE_DT_GET(DT_NODELABEL(remote_dt7));
#else
	return nullptr;
#endif
}

/**
 * @brief UART 字节回调（中断上下文）：拼满一帧就丢给线程
 *
 */
void RxCallback(const struct device* /*dev*/,
                remote_rx_event_t event,
                const std::uint8_t* data,
                std::size_t length,
                void* /*userData*/
)
{
	if (event == REMOTE_RX_RESET)
	{
		rxFrameLength = 0;
		return;
	}
	if (event != REMOTE_RX_DATA)
	{
		return;
	}

	// DT7 无帧头无 CRC，只能靠帧间隙重新对齐
	const std::uint32_t now = k_uptime_get_32();
	if (now - lastRxTimestamp >= FRAME_GAP_MS)
	{
		rxFrameLength = 0;
	}
	lastRxTimestamp = now;

	for (std::size_t i = 0; i < length; ++i)
	{
		rxFrame[rxFrameLength] = data[i];
		++rxFrameLength;
		if (rxFrameLength == rxFrame.size())
		{
			rxFrameLength = 0;
			k_msgq_put(&rxFrameQueue, rxFrame.data(), K_NO_WAIT);
		}
	}
}

/**
 * @brief 解析线程：把整帧交给驱动解析器，然后回调使用方
 *
 */
void RxThreadEntry(void* /*p1*/, void* /*p2*/, void* /*p3*/)
{
	std::array<std::uint8_t, FRAME_SIZE> frame{};

	for (;;)
	{
		k_msgq_get(&rxFrameQueue, frame.data(), K_FOREVER);

		// 驱动的解析器直接写 sensorPointer->info
		parserOps->parse(frame.data(), sensorPointer->info);

		if (frameCallback != nullptr)
		{
			frameCallback(sensorPointer, frameCallbackData);
		}
	}
}

} // namespace

const rc_sensor_t* Init(FrameCallback callback, void* userData)
{
	if (remoteDevice != nullptr)
	{
		return sensorPointer;
	}

	const struct device* device = ResolveDevice();
	if (device == nullptr || !device_is_ready(device))
	{
		LOG_ERR("remote device not ready");
		return nullptr;
	}

	rc_sensor_t* sensor = remote_get_sensor(device);
	const rc_parser_ops_t* ops = remote_get_parser_ops(device);
	if (sensor == nullptr || ops == nullptr || ops->parse == nullptr)
	{
		LOG_ERR("device has no sensor / parser ops");
		return nullptr;
	}

	sensorPointer = sensor;
	parserOps = ops;
	frameCallback = callback;
	frameCallbackData = userData;
	lastRxTimestamp = k_uptime_get_32();

	k_thread_create(&rxThread, rxThreadStack, K_THREAD_STACK_SIZEOF(rxThreadStack), RxThreadEntry, nullptr, nullptr,
	                nullptr, THREAD_PRIO, 0, K_NO_WAIT);
	k_thread_name_set(&rxThread, "chassis_remote");

	remote_set_rx_cb(device, RxCallback, nullptr);
	remoteDevice = device;

	LOG_INF("remote registered");
	return sensorPointer;
}

Control::Target TargetFrom(const rc_sensor_info_t& info)
{
	Control::Target target{};
	target.Vx = static_cast<float>(info.ch0) / CHANNEL_MAX * MAX_VX_SPEED;
	target.Vy = static_cast<float>(info.ch1) / CHANNEL_MAX * MAX_VY_SPEED;
	return target;
}

} // namespace breeze::chassis::remote
```
