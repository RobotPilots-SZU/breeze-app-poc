## CMakeLists.txt
```
cmake_minimum_required(VERSION 3.20)

if(NOT BOARD)
    set(BOARD rm_typec)
endif()

list(APPEND ZEPHYR_EXTRA_MODULES
    "${WEST_TOPDIR}/breeze-modules"
    "${WEST_TOPDIR}/lob-hero/common"
)

find_package(Zephyr REQUIRED HINTS $ENV{ZEPHYR_BASE})

project(lob-hero-up)

file(GLOB_RECURSE APP_SOURCES CONFIGURE_DEPNDS
	"${CMAKE_CURRENT_LIST_DIR}/src/*.cpp"
)

target_sources(app
	PRIVATE
		${APP_SOURCES}
)

target_include_directories(app
	PRIVATE
		"${CMAKE_CURRENT_LIST_DIR}/inc"
)

target_link_libraries(app
	PRIVATE
		lob_hero::interface
        lob_hero::b2b
        lob_hero::sensors
        lob_hero::motors
		breeze::module::b2b
)
```

## prj.conf
```kconfig
CONFIG_GPIO=y
CONFIG_SPI=y
CONFIG_SENSOR=y

CONFIG_BREEZE=y
CONFIG_CPP=y
CONFIG_STD_CPP20=y
CONFIG_RAMENX=y
CONFIG_GLIBCXX_LIBCPP=y
CONFIG_REQUIRES_FULL_LIBCPP=y
CONFIG_LOG=y
CONFIG_THREAD_NAME=y
CONFIG_BREEZE_MODULES=y
CONFIG_ALGO=y

CONFIG_CAN=y
CONFIG_ISOTP=y

CONFIG_FLASH=y
CONFIG_DEBUG=y
CONFIG_DEBUG_OPTIMIZATIONS=y
CONFIG_THREAD_MONITOR=y
CONFIG_DEBUG_THREAD_INFO=y

CONFIG_USE_SEGGER_RTT=y
CONFIG_RTT_CONSOLE=y
CONFIG_UART_CONSOLE=n

CONFIG_LOG_BACKEND_RTT=y
CONFIG_LOG_BACKEND_UART=n
CONFIG_LOG_PROCESS_THREAD_STACK_SIZE=2048
CONFIG_LOG_BACKEND_RTT_MODE_DROP=y
CONFIG_LOG_BACKEND_RTT_MODE_BLOCK=n
```

## boards/rm_typec.overlay
```dts
/* DT7 receiver on the rm_typec USART3 RX pin (PC11). */

&usart3 {
	parity = "even";
};

/ {
    can_rx_mgr1: can_rx_mgr1 {
        compatible = "rp,can-rx-manager";
        status = "okay";
        can-bus = <&can1>;
        label = "can_rx_mgr1";
    };

    can_tx_mgr1: can_tx_mgr1 {
        compatible = "rp,can-tx-manager";
        status = "okay";
        can-bus = <&can1>;
        label = "can_tx_mgr1";
    };

	// gimbal_pitch: gimbal_pitch {
	// 	compatible = "rp,dm-can-motor";
	// 	status = "okay";
	// 	can-bus = <&can1>;
	// 	rx-manager = <&can_rx_mgr1>;
	// 	tx-manager = <&can_tx_mgr1>;
	// 	tx-id = <0x06>;
	// 	rx-id = <0x32>;
	// 	motor-type = "DM80";
	// 	label = "gimbal_pitch";
	// 	Tx-feq = <1000>;
	// 	motor-encoder = <65535>;
	// 	motor-transmission-ratio = <9>; // TODO: 找具体减速比
	// 	control-mode = "MIT";
	// };
};
```

## src/main.cpp
```c
#include <app/b2b.hpp>
#include <app/models/priority.hpp>
#include <app/sensors/imu.hpp>
#include <app/tracer.hpp>
#include <ramenx/time.hpp>

namespace
{
using namespace app;

ramen::FrameProvider<1024> traceFrame{
    {.period = K_MSEC(1000), .priority = models::priority::TRACE_TICK, .name = "trace_tick"}
};
ramen::FrameProvider<2048> sensorFrame{
    {.period = K_MSEC(1), .priority = models::priority::SENSOR_TICK, .name = "sensor_tick"}
};

/**
 * @brief 云台imu模块
 * @note 目前测试发现水平静置时, roll约为~179,
 * pitch向上为正, 水平为0
 * yaw 在上电位置为0, 左转为正
 */
sensors::Imu headImu{
    DEVICE_DT_GET(DT_NODELABEL(bmi08x_accel)),
    DEVICE_DT_GET(DT_NODELABEL(bmi08x_gyro)),
    // 默认参数
    {}
};

b2b::UpModule b2bCom{DEVICE_DT_GET(DT_NODELABEL(can1)), K_MSEC(10)};

Tracer tracer{};

} // namespace

namespace app
{

void Start()
{
	traceFrame.start();
	sensorFrame.start();

	headImu.Start();
	b2bCom.Start();
}
void Connect()
{
	sensorFrame.out >> headImu.InTick;
	traceFrame.out >> tracer.InTick;

	tracer.InImu >> headImu.OutAngular;
}
} // namespace app

int main()
{
	app::Connect();
	app::Start();
}
```

## src/b2b.cpp
```c
#include <app/b2b.hpp>
#include <app/b2b/msg.hpp>
#include <app/b2b/msgconvert.hpp>
#include <app/models/priority.hpp>
#include <breeze/b2b/proto.hpp>
#include <breeze/b2b/transmit.hpp>
#include <breeze/models/utils.hpp>
#include <etl/array.h>
#include <etl/span.h>
#include <memory>
#include <new>
#include <ramenx/async.hpp>
#include <ramenx/time.hpp>

namespace
{

using namespace app::b2b;

struct CastHandler
{
	Output& Out;

	void Handle(const MotorControl& in)
	{
		if (std::ranges::find(app::models::MOTOR_IDS, in.Id) == app::models::MOTOR_IDS.end())
		{
			return;
		}
		if (auto* p = Out.Motors.At(in.Id); p != nullptr)
		{
			(*p)(FromProto(in));
		}
	}
};

struct B2BCast
{
	ramen::ThreadLift<etl::span<const std::byte>, 512> Lift{
	    ramen::DispatcherConfig{.priority = app::models::priority::B2B_CAST_TRANS, .name = "b2b_lift"}
	};
	ramen::FrameProvider<1024> Collector;
	breeze::b2b::Transmitter Transmitter;
	etl::array<std::byte, 512> TransmitterBuffer;

	CastHandler Handler;
	Input& In;
	breeze::b2b::Encoder<CastMessages> Encoder;
	breeze::b2b::Decoder<CastMessages> Decoder;

	ramen::Pushable<etl::span<const std::byte>> InHandleRx = [this](const auto data) { Decoder.Decode(data, Handler); };
	ramen::Pushable<> InCollect = [this] { Collect(); };

	// NOLINTNEXTLINE(cppcoreguidelines-pro-type-member-init)
	B2BCast(const device* dev, Output& out, Input& in, k_timeout_t collectPeriod)
	    : Collector({
	          .period = collectPeriod,
	          .priority = app::models::priority::B2B_CAST_COLLECT,
	          .name = "b2b_collect",
	      }),
	      Transmitter(dev, {
	          .RxDataId = UP_ADDR.B2B,
	          .TxFcId = DOWN_ADDR.B2BFc,
	          .TxDataId = DOWN_ADDR.B2B,
	          .RxFcId = UP_ADDR.B2BFc,
	          .Buffer = TransmitterBuffer,
	      }),
	      Handler{out},
	      In{in}
	{
		Lift.in_wait >> Transmitter.OutReceiveWait;
		Lift.out >> InHandleRx;
		Collector.out >> InCollect;
	}

	void Start()
	{
		Transmitter.Start();
		Lift.start();
		Collector.start();
	}

	void Collect()
	{
		for (const auto id : app::models::UP_MOTORS)
		{
			if (auto* puller = In.Motors.At(id); puller != nullptr)
			{
				// NOLINTNEXTLINE(cppcoreguidelines-pro-type-member-init)
				breeze::models::MotorReport report;
				(*puller)(report);
				const auto message = ToProto(report, id);
				Transmitter.InSend(Encoder.Encode(message, TransmitterBuffer));
			}
		}
		for (const auto id : app::models::UP_IMUS)
		{
			if (auto* puller = In.Imus.At(id); puller != nullptr)
			{
				// NOLINTNEXTLINE(cppcoreguidelines-pro-type-member-init)
				breeze::models::ImuAngularReport report;
				(*puller)(report);
				if (report != decltype(report){})
				{
					const auto message = ToProto(report, id);
					Transmitter.InSend(Encoder.Encode(message, TransmitterBuffer));
				}
			}
		}
	}
};

} // namespace

namespace app::b2b
{

// 内部实现分层. 分为B2B Cast 和 RP-Proto
struct UpModule::Impl
{
	B2BCast Cast;
	Impl(const device* dev, Output& out, Input& in, k_timeout_t collectPeriod)
	    : Cast(dev, out, in, collectPeriod)
	{}
	void Start() { Cast.Start(); }
};

// NOLINTNEXTLINE(cppcoreguidelines-pro-type-member-init)
UpModule::UpModule(const device* dev, k_timeout_t collectPeriod)
    : In{
          .Motors = MotorReportPullers{[]<typename TId>(TId) { return ramen::Puller<breeze::models::MotorReport>{}; }},
          .Imus = ImuReportPullers{[]<typename TId>(TId) { return ramen::Puller<breeze::models::ImuAngularReport>{}; }},
      }
{
	static_assert(sizeof(Impl) <= IMPL_SIZE);
	std::construct_at(P(), dev, Out, In, collectPeriod);
}
void UpModule::Start() { P()->Start(); }

UpModule::Impl* UpModule::P() { return std::launder(reinterpret_cast<Impl*>(&_storage)); }

} // namespace app::b2b
```

## src/tracer.cpp
```c
#include <app/tracer.hpp>
#include <breeze/models/device.hpp>
#include <zephyr/logging/log.h>

LOG_MODULE_REGISTER(TRACER);

using namespace breeze::models;

namespace app
{
#pragma clang diagnostic push
#pragma clang diagnostic ignored "-Wdouble-promotion"
// NOLINTBEGIN(readability-simplify-boolean-expr)
void Tracer::OnTick() const
{
	if (auto ret = *InImu; ret != decltype(ret){})
	{
		LOG_INF("Imu value:");
		LOG_INF(
		    "\tv: y=%.2f, r=%.2f, p=%.2f", ret.Yaw.Value, ret.Roll.Value, ret.Pitch.Value // 角度
		);
		LOG_INF(
		    "\tr: y=%.2f, r=%.2f, p=%.2f", ret.YawRate.Value, ret.RollRate.Value,
		    ret.PitchRate.Value // 角速度
		);
	}
}
#pragma clang diagnostic pop
// NOLINTEND(readability-simplify-boolean-expr)
} // namespace app
```
