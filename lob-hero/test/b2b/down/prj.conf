## CMakeLists.txt
```
cmake_minimum_required(VERSION 3.20)

if(NOT BOARD)
	set(BOARD rm_typec)
endif()

set(DTC_OVERLAY_FILE "${WEST_TOPDIR}/lob-hero/down/boards/rm_typec.overlay"
	CACHE STRING "Devicetree overlay for the B2B down test" FORCE)

list(APPEND ZEPHYR_EXTRA_MODULES
	"${WEST_TOPDIR}/breeze-modules"
	"${WEST_TOPDIR}/lob-hero/common"
)

find_package(Zephyr REQUIRED HINTS $ENV{ZEPHYR_BASE})
project(lob_hero_b2b_down_test)

set(B2B_TEST_MODE "board" CACHE STRING "B2B test mode")
set_property(CACHE B2B_TEST_MODE PROPERTY STRINGS board raw_loopback module_loopback raw_can raw_isotp can1_can2)
set(B2B_TEST_ROLE "rx" CACHE STRING "Raw test role: tx or rx")
set_property(CACHE B2B_TEST_ROLE PROPERTY STRINGS tx rx)
if(B2B_TEST_MODE STREQUAL "board")
  set(B2B_TEST_SOURCE src/main.cpp)
elseif(B2B_TEST_MODE STREQUAL "raw_loopback")
  set(B2B_TEST_SOURCE src/raw_loopback.cpp)
elseif(B2B_TEST_MODE STREQUAL "module_loopback")
  set(B2B_TEST_SOURCE src/module_loopback.cpp)
elseif(B2B_TEST_MODE STREQUAL "raw_can")
  set(B2B_TEST_SOURCE src/raw_can.cpp)
elseif(B2B_TEST_MODE STREQUAL "raw_isotp")
  set(B2B_TEST_SOURCE src/raw_isotp.cpp)
elseif(B2B_TEST_MODE STREQUAL "can1_can2")
  set(B2B_TEST_SOURCE src/can1_can2.cpp)
else()
  message(FATAL_ERROR "Unknown B2B_TEST_MODE: ${B2B_TEST_MODE}")
endif()

if((B2B_TEST_MODE STREQUAL "raw_can" OR B2B_TEST_MODE STREQUAL "raw_isotp")
  AND NOT (B2B_TEST_ROLE STREQUAL "tx" OR B2B_TEST_ROLE STREQUAL "rx"))
  message(FATAL_ERROR "B2B_TEST_ROLE must be tx or rx")
endif()

target_sources(app PRIVATE
  "${CMAKE_CURRENT_LIST_DIR}/${B2B_TEST_SOURCE}"
	"${WEST_TOPDIR}/lob-hero/down/src/b2b/module.cpp"
)

target_include_directories(app PRIVATE
	"${WEST_TOPDIR}/lob-hero/down/inc"
)

if(B2B_TEST_MODE STREQUAL "raw_can" OR B2B_TEST_MODE STREQUAL "raw_isotp")
  string(TOUPPER "${B2B_TEST_ROLE}" B2B_TEST_ROLE_UPPER)
  target_compile_definitions(app PRIVATE B2B_TEST_ROLE_${B2B_TEST_ROLE_UPPER}=1)
endif()

target_link_libraries(app PRIVATE
	lob_hero::interface
	lob_hero::b2b
	breeze::module::b2b
)
```

## prj.conf
```kconfig
CONFIG_CPP=y
CONFIG_STD_CPP20=y
CONFIG_RAMENX=y
CONFIG_GLIBCXX_LIBCPP=y
CONFIG_REQUIRES_FULL_LIBCPP=y
CONFIG_LOG=y
CONFIG_THREAD_NAME=y
CONFIG_CAN=y
CONFIG_ISOTP=y
CONFIG_BREEZE=y
CONFIG_BREEZE_MODULES=y
CONFIG_ALGO=y

CONFIG_FLASH=y
CONFIG_DEBUG=y
CONFIG_DEBUG_OPTIMIZATIONS=y
CONFIG_THREAD_MONITOR=y
CONFIG_DEBUG_THREAD_INFO=y

CONFIG_LOG_PROCESS_THREAD_STACK_SIZE=2048
```

## src/main.cpp
```c
#include "ramen.hpp"
#include <app/b2b/module.hpp>
#include <app/models/device.hpp>
#include <breeze/models/device.hpp>
#include <zephyr/device.h>
#include <zephyr/kernel.h>
#include <zephyr/logging/log.h>

LOG_MODULE_REGISTER(b2b_down_test);

using namespace breeze::models;

static app::b2b::DownModule b2b{DEVICE_DT_GET(DT_NODELABEL(can1))};
static ramen::Puller<ImuAngularReport> inImu;
/**
 * @brief 来自上板的imu值, 监视该变量即可.
 *
 */
static ImuAngularReport imu{};

int main()
{
	inImu >> b2b.Out.Imus[app::models::ImuId::Head];
	b2b.Start();

	while (true)
	{
		imu = *inImu;
		LOG_INF("Imu: yaw=%.2f, pitch=%.2f, roll=%.2f", imu.Yaw.Value, imu.Pitch.Value, imu.Roll.Value);
		k_sleep(K_MSEC(100));
	}
}
```

## src/can1_can2.cpp
```c
/* SPDX-FileCopyrightText: Copyright (c) 2026 RobotPilots-SZU */
/* SPDX-License-Identifier: Apache-2.0 */

#include <array>
#include <cstdint>
#include <errno.h>
#include <zephyr/device.h>
#include <zephyr/drivers/can.h>
#include <zephyr/kernel.h>
#include <zephyr/logging/log.h>

LOG_MODULE_REGISTER(b2b_can1_can2_test, LOG_LEVEL_INF);

namespace
{
constexpr std::uint32_t Can1ToCan2Id = 0x341U;
constexpr std::uint32_t Can2ToCan1Id = 0x342U;
constexpr k_timeout_t RxTimeout = K_SECONDS(3);
CAN_MSGQ_DEFINE(Can1RxQueue, 2);
CAN_MSGQ_DEFINE(Can2RxQueue, 2);

constexpr std::array<std::uint8_t, CAN_MAX_DLC> Can1ToCan2Data{0xA1, 1, 2, 3, 4, 5, 6, 7};
constexpr std::array<std::uint8_t, CAN_MAX_DLC> Can2ToCan1Data{0xA2, 1, 2, 3, 4, 5, 6, 7};

int InstallFilter(const device* can, k_msgq* queue, std::uint32_t id)
{
	const can_filter filter{.id = id, .mask = CAN_STD_ID_MASK, .flags = 0U};
	const int filterId = can_add_rx_filter_msgq(can, queue, &filter);
	if (filterId < 0) {
		LOG_ERR("CAN %s: failed to install filter 0x%x: %d", can->name, id, filterId);
	}
	return filterId;
}

bool ReceiveAndCheck(k_msgq* queue, std::uint32_t id,
		     const std::array<std::uint8_t, CAN_MAX_DLC>& expected)
{
	can_frame frame{};
	const int ret = k_msgq_get(queue, &frame, RxTimeout);
	if (ret != 0) {
		LOG_ERR("RX timeout waiting for CAN ID 0x%x: %d", id, ret);
		return false;
	}

	bool valid = frame.id == id && frame.flags == 0U && frame.dlc == expected.size();
	for (std::size_t i = 0; valid && i < expected.size(); ++i) {
		valid = frame.data[i] == expected[i];
	}
	LOG_INF("RX id=0x%x dlc=%u %s", frame.id, frame.dlc, valid ? "PASS" : "FAIL");
	return valid;
}

bool SendFrame(const device* can, std::uint32_t id,
	       const std::array<std::uint8_t, CAN_MAX_DLC>& data)
{
	can_frame frame{.id = id, .dlc = CAN_MAX_DLC, .flags = 0U, .data = {}};
	for (std::size_t i = 0; i < data.size(); ++i) {
		frame.data[i] = data[i];
	}
	const int ret = can_send(can, &frame, K_SECONDS(1), nullptr, nullptr);
	if (ret != 0) {
		can_state state{};
		can_bus_err_cnt errors{};
		const int stateRet = can_get_state(can, &state, &errors);
		if (stateRet == 0) {
			LOG_ERR("CAN %s TX 0x%x failed: %d state=%d TEC=%u REC=%u", can->name, id,
				ret, static_cast<int>(state), errors.tx_err_cnt, errors.rx_err_cnt);
		} else {
			LOG_ERR("CAN %s TX 0x%x failed: %d; state read failed: %d", can->name, id,
				ret, stateRet);
		}
		return false;
	}
	LOG_INF("CAN %s TX id=0x%x PASS", can->name, id);
	return true;
}

int StartNormalOneShot(const device* can)
{
	int ret = can_set_mode(can, CAN_MODE_NORMAL | CAN_MODE_ONE_SHOT);
	if (ret == 0) {
		ret = can_start(can);
	}
	if (ret == -EALREADY) {
		ret = 0;
	}
	if (ret != 0) {
		LOG_ERR("CAN %s failed to start in normal one-shot mode: %d", can->name, ret);
	}
	return ret;
}
}

int main()
{
	const device* can1 = DEVICE_DT_GET(DT_NODELABEL(can1));
	const device* can2 = DEVICE_DT_GET(DT_NODELABEL(can2));
	if (!device_is_ready(can1) || !device_is_ready(can2)) {
		LOG_ERR("CAN1 or CAN2 device is not ready");
		return 1;
	}

	const int can1Filter = InstallFilter(can1, &Can1RxQueue, Can2ToCan1Id);
	if (can1Filter < 0) {
		return 1;
	}
	const int can2Filter = InstallFilter(can2, &Can2RxQueue, Can1ToCan2Id);
	if (can2Filter < 0) {
		can_remove_rx_filter(can1, can1Filter);
		return 1;
	}
	int ret = StartNormalOneShot(can1);
	if (ret == 0) {
		ret = StartNormalOneShot(can2);
	}
	if (ret != 0) {
		can_remove_rx_filter(can2, can2Filter);
		can_remove_rx_filter(can1, can1Filter);
		return 1;
	}
	LOG_INF("CAN1/CAN2 ready: 1 Mbit/s expected, normal one-shot mode");
	k_sleep(K_SECONDS(2));

	const bool requestSent = SendFrame(can1, Can1ToCan2Id, Can1ToCan2Data);
	const bool requestReceived = requestSent &&
				     ReceiveAndCheck(&Can2RxQueue, Can1ToCan2Id, Can1ToCan2Data);
	const bool responseSent = requestReceived &&
				  SendFrame(can2, Can2ToCan1Id, Can2ToCan1Data);
	const bool responseReceived = responseSent &&
				      ReceiveAndCheck(&Can1RxQueue, Can2ToCan1Id, Can2ToCan1Data);
	const bool passed = requestSent && requestReceived && responseSent && responseReceived;

	LOG_INF("CAN1/CAN2 SUMMARY: %s", passed ? "PASS" : "FAIL");
	can_remove_rx_filter(can2, can2Filter);
	can_remove_rx_filter(can1, can1Filter);
	return passed ? 0 : 1;
}
```

## src/module_loopback.cpp
```c
#include <app/b2b/module.hpp>
#include <app/b2b/msg.hpp>
#include <breeze/b2b/proto.hpp>
#include <breeze/models/device.hpp>
#include <cstddef>
#include <cstdint>
#include <errno.h>
#include <etl/array.h>
#include <zephyr/canbus/isotp.h>
#include <zephyr/device.h>
#include <zephyr/kernel.h>
#include <zephyr/logging/log.h>

LOG_MODULE_REGISTER(b2b_down_module_loopback, LOG_LEVEL_INF);

namespace
{

constexpr std::size_t PEER_RX_SIZE = 32;

const device* Can = DEVICE_DT_GET(DT_NODELABEL(can1));
isotp_recv_ctx PeerRecvCtx{};
isotp_send_ctx PeerSendCtx{};
K_SEM_DEFINE(PeerReceiverReady, 0, 1);
K_SEM_DEFINE(PeerReceiveDone, 0, 1);
K_THREAD_STACK_DEFINE(PeerReceiverStack, 2048);
k_thread PeerReceiverThread{};
etl::array<std::uint8_t, PEER_RX_SIZE> PeerRxData{};
int PeerRxLength = ISOTP_RECV_TIMEOUT;

const isotp_msg_id PeerRxAddr{
	.std_id = app::b2b::UP_ADDR.B2B,
	.flags = ISOTP_MSG_EXT_ADDR,
};
const isotp_msg_id PeerTxAddr{
	.std_id = app::b2b::DOWN_ADDR.B2B,
	.flags = ISOTP_MSG_EXT_ADDR,
};
const isotp_msg_id PeerRxFcAddr{
	.std_id = app::b2b::UP_ADDR.B2BFc,
	.flags = ISOTP_MSG_EXT_ADDR,
};
const isotp_msg_id PeerTxFcAddr{
	.std_id = app::b2b::DOWN_ADDR.B2BFc,
	.flags = ISOTP_MSG_EXT_ADDR,
};
const isotp_fc_opts FcOpts{
	.bs = 8,
	.stmin = 5,
};

void PeerReceiver(void*, void*, void*)
{
	k_sem_give(&PeerReceiverReady);
	std::size_t total = 0;
	while (total < PeerRxData.size()) {
		const auto received = isotp_recv(&PeerRecvCtx, PeerRxData.data() + total,
						 PeerRxData.size() - total, K_SECONDS(5));
		if (received <= 0) {
			PeerRxLength = received;
			k_sem_give(&PeerReceiveDone);
			return;
		}
		total += static_cast<std::size_t>(received);
		if (total >= sizeof(std::uint8_t) + sizeof(app::b2b::MotorControl)) {
			break;
		}
	}
	PeerRxLength = static_cast<int>(total);
	k_sem_give(&PeerReceiveDone);
}

} // namespace

int main()
{
	if (!device_is_ready(Can)) {
		LOG_ERR("CAN device is not ready");
		return 0;
	}
	int ret = can_set_mode(Can, CAN_MODE_LOOPBACK);
	if (ret != 0) {
		LOG_ERR("can_set_mode(loopback) failed: %d", ret);
		return 0;
	}
	ret = can_start(Can);
	if (ret != 0 && ret != -EALREADY) {
		LOG_ERR("can_start failed: %d", ret);
		return 0;
	}

	ret = isotp_bind(&PeerRecvCtx, Can, &PeerRxAddr, &PeerTxFcAddr, &FcOpts, K_SECONDS(1));
	if (ret != 0) {
		LOG_ERR("Peer isotp_bind failed: %d", ret);
		return 0;
	}

	static app::b2b::DownModule b2b{Can};
	b2b.Start();

	breeze::b2b::Encoder<app::b2b::CastMessages> encoder;
	etl::array<std::byte, 32> txBuffer{};
	const app::b2b::ImuReport imuReport{
		.Id = app::models::ImuId::Head,
		.Yaw = 1000,
		.Roll = -250,
		.Pitch = 375,
		.YawRate = 500,
		.RollRate = -125,
		.PitchRate = 250,
	};
	const auto imuPayload = encoder.Encode(imuReport, txBuffer);
	ret = isotp_send(&PeerSendCtx, Can,
			 reinterpret_cast<const std::uint8_t*>(imuPayload.data()), imuPayload.size(),
			 &PeerTxAddr, &PeerRxFcAddr, nullptr, nullptr);
	LOG_INF("Peer IMU send result: %d", ret);
	const bool imuSent = ret == 0;
	k_sleep(K_MSEC(100));

	breeze::models::ImuAngularReport receivedImu{};
	b2b.Out.Imus[app::models::ImuId::Head](receivedImu);
	const bool imuPass = imuSent && receivedImu.Yaw.Value == 10.0F &&
			     receivedImu.Roll.Value == -2.5F &&
			     receivedImu.Pitch.Value == 3.75F &&
			     receivedImu.YawRate.Value == 5.0F &&
			     receivedImu.RollRate.Value == -1.25F &&
			     receivedImu.PitchRate.Value == 2.5F;
	LOG_INF("DownModule IMU: yaw=%.2f roll=%.2f pitch=%.2f: %s",
		static_cast<double>(receivedImu.Yaw.Value), static_cast<double>(receivedImu.Roll.Value),
		static_cast<double>(receivedImu.Pitch.Value),
		imuPass ? "PASS" : "FAIL");

	k_thread_create(&PeerReceiverThread, PeerReceiverStack, K_THREAD_STACK_SIZEOF(PeerReceiverStack),
			PeerReceiver, nullptr, nullptr, nullptr, K_PRIO_PREEMPT(5), 0, K_NO_WAIT);
	(void)k_sem_take(&PeerReceiverReady, K_SECONDS(1));
	const breeze::models::MotorControl control{.Torque = {0.5F}};
	b2b.In.Motors[app::models::MotorId::HeadPitch](control);
	ret = k_sem_take(&PeerReceiveDone, K_SECONDS(6));
	const bool motorPass = ret == 0 && PeerRxLength == 4 &&
			PeerRxData[0] == app::b2b::MotorControl::ID &&
			PeerRxData[1] == static_cast<std::uint8_t>(app::models::MotorId::HeadPitch) &&
			PeerRxData[2] == 0x00 && PeerRxData[3] == 0x40;
	LOG_INF("DownModule MotorControl RX length=%d: %s", PeerRxLength,
		motorPass ? "PASS" : "FAIL");
	LOG_INF("MODULE LOOPBACK SUMMARY: %s", imuPass && motorPass ? "PASS" : "FAIL");

	k_sleep(K_SECONDS(1));
	isotp_unbind(&PeerRecvCtx);
	return 0;
}
```

## src/raw_can.cpp
```c
/* SPDX-FileCopyrightText: Copyright (c) 2026 RobotPilots-SZU */
/* SPDX-License-Identifier: Apache-2.0 */

#include <array>
#include <cstdint>
#include <errno.h>
#include <zephyr/device.h>
#include <zephyr/drivers/can.h>
#include <zephyr/kernel.h>
#include <zephyr/logging/log.h>

LOG_MODULE_REGISTER(b2b_raw_can_test, LOG_LEVEL_INF);

namespace
{
constexpr std::uint32_t RequestId = 0x321U;
constexpr std::uint32_t ResponseId = 0x322U;
constexpr k_timeout_t RxTimeout = K_SECONDS(10);
CAN_MSGQ_DEFINE(RxQueue, 2);

constexpr std::array<std::uint8_t, CAN_MAX_DLC> RequestData{0xA0, 1, 2, 3, 4, 5, 6, 7};
constexpr std::array<std::uint8_t, CAN_MAX_DLC> ResponseData{0xB0, 1, 2, 3, 4, 5, 6, 7};

bool ReceiveAndCheck(std::uint32_t id, const std::array<std::uint8_t, CAN_MAX_DLC>& expected)
{
	can_frame frame{};
	const int ret = k_msgq_get(&RxQueue, &frame, RxTimeout);
	if (ret != 0) {
		LOG_ERR("RX timeout waiting for CAN ID 0x%x: %d", id, ret);
		return false;
	}

	bool valid = frame.id == id && frame.flags == 0U && frame.dlc == expected.size();
	for (std::size_t i = 0; valid && i < expected.size(); ++i) {
		valid = frame.data[i] == expected[i];
	}
	LOG_INF("RX id=0x%x dlc=%u %s", frame.id, frame.dlc, valid ? "PASS" : "FAIL");
	return valid;
}

int InstallFilter(const device* can, std::uint32_t id)
{
	const can_filter filter{.id = id, .mask = CAN_STD_ID_MASK, .flags = 0U};
	const int filterId = can_add_rx_filter_msgq(can, &RxQueue, &filter);
	if (filterId < 0) {
		LOG_ERR("Failed to install filter for 0x%x: %d", id, filterId);
	}
	return filterId;
}

bool SendFrame(const device* can, std::uint32_t id,
	       const std::array<std::uint8_t, CAN_MAX_DLC>& data)
{
	can_frame frame{.id = id, .dlc = CAN_MAX_DLC, .flags = 0U, .data = {}};
	for (std::size_t i = 0; i < data.size(); ++i) {
		frame.data[i] = data[i];
	}
	const int ret = can_send(can, &frame, K_SECONDS(2), nullptr, nullptr);
	if (ret != 0) {
		can_state state{};
		can_bus_err_cnt errors{};
		(void)can_get_state(can, &state, &errors);
		LOG_ERR("TX id=0x%x failed: %d state=%d TEC=%u REC=%u", id, ret,
			static_cast<int>(state), errors.tx_err_cnt, errors.rx_err_cnt);
		return false;
	}
	LOG_INF("TX id=0x%x PASS", id);
	return true;
}
}

int main()
{
	const device* can = DEVICE_DT_GET(DT_NODELABEL(can1));
	if (!device_is_ready(can)) {
		LOG_ERR("CAN1 device is not ready");
		return 1;
	}

#if defined(B2B_TEST_ROLE_TX)
	constexpr std::uint32_t rxId = ResponseId;
#else
	constexpr std::uint32_t rxId = RequestId;
#endif
	const int filterId = InstallFilter(can, rxId);
	if (filterId < 0) {
		return 1;
	}
	int ret = can_set_mode(can, CAN_MODE_NORMAL);
	if (ret == 0) {
		ret = can_start(can);
	}
	if (ret != 0 && ret != -EALREADY) {
		LOG_ERR("Failed to start CAN1 in normal mode: %d", ret);
		can_remove_rx_filter(can, filterId);
		return 1;
	}
	LOG_INF("CAN1 normal mode ready, role=%s",
#if defined(B2B_TEST_ROLE_TX)
		"tx");
#else
		"rx");
#endif

#if defined(B2B_TEST_ROLE_TX)
	k_sleep(K_SECONDS(2));
	const bool passed = SendFrame(can, RequestId, RequestData) &&
			    ReceiveAndCheck(ResponseId, ResponseData);
#else
	const bool received = ReceiveAndCheck(RequestId, RequestData);
	const bool passed = received && SendFrame(can, ResponseId, ResponseData);
#endif
	LOG_INF("RAW CAN SUMMARY: %s", passed ? "PASS" : "FAIL");
	can_remove_rx_filter(can, filterId);
	return passed ? 0 : 1;
}
```

## src/raw_isotp.cpp
```c
/* SPDX-FileCopyrightText: Copyright (c) 2026 RobotPilots-SZU */
/* SPDX-License-Identifier: Apache-2.0 */

#include <array>
#include <cstddef>
#include <cstdint>
#include <errno.h>
#include <zephyr/canbus/isotp.h>
#include <zephyr/device.h>
#include <zephyr/drivers/can.h>
#include <zephyr/kernel.h>
#include <zephyr/logging/log.h>
#include <zephyr/net_buf.h>

LOG_MODULE_REGISTER(b2b_raw_isotp_test, LOG_LEVEL_INF);

namespace
{
constexpr std::uint32_t RequestDataId = 0x321U;
constexpr std::uint32_t RequestFcId = 0x322U;
constexpr std::uint32_t ResponseDataId = 0x323U;
constexpr std::uint32_t ResponseFcId = 0x324U;
constexpr std::size_t PayloadSize = 20U;
constexpr k_timeout_t RxTimeout = K_SECONDS(10);

#if defined(B2B_TEST_ROLE_TX)
isotp_recv_ctx ResponseRecvCtx{};
#else
isotp_recv_ctx RequestRecvCtx{};
#endif
isotp_send_ctx SendCtx{};

std::array<std::uint8_t, PayloadSize> MakePayload(std::uint8_t seed)
{
	std::array<std::uint8_t, PayloadSize> payload{};
	for (std::size_t i = 0; i < payload.size(); ++i) {
		payload[i] = static_cast<std::uint8_t>(seed + i);
	}
	return payload;
}

bool ReceiveAndCheck(isotp_recv_ctx* ctx,
		     const std::array<std::uint8_t, PayloadSize>& expected)
{
	std::array<std::uint8_t, PayloadSize> received{};
	std::size_t total = 0U;
	int remaining = 0;
	do {
		net_buf* buffer = nullptr;
		remaining = isotp_recv_net(ctx, &buffer, RxTimeout);
		if (remaining < 0) {
			LOG_ERR("ISO-TP receive failed: %d", remaining);
			return false;
		}
		const std::size_t chunk = net_buf_frags_len(buffer);
		if (chunk > received.size() - total) {
			net_buf_unref(buffer);
			LOG_ERR("ISO-TP receive exceeded test payload size");
			return false;
		}
		const std::size_t copied = net_buf_linearize(received.data() + total,
							     received.size() - total, buffer, 0, chunk);
		net_buf_unref(buffer);
		if (copied != chunk) {
			LOG_ERR("ISO-TP receive copy mismatch: %u/%u",
				static_cast<unsigned int>(copied), static_cast<unsigned int>(chunk));
			return false;
		}
		total += copied;
		if (static_cast<std::size_t>(remaining) != received.size() - total) {
			LOG_ERR("ISO-TP remaining length mismatch: remaining=%d total=%u",
				remaining, static_cast<unsigned int>(total));
			return false;
		}
	} while (remaining != 0);

	const bool passed = total == expected.size() && received == expected;
	LOG_INF("ISO-TP RX bytes=%u %s", static_cast<unsigned int>(total),
		passed ? "PASS" : "FAIL");
	return passed;
}

int Bind(isotp_recv_ctx* ctx, const device* can, std::uint16_t rxId, std::uint16_t fcId)
{
	isotp_msg_id rxAddr{};
	isotp_msg_id fcAddr{};
	rxAddr.std_id = rxId;
	fcAddr.std_id = fcId;
	const isotp_fc_opts options{.bs = 8U, .stmin = 5U};
	return isotp_bind(ctx, can, &rxAddr, &fcAddr, &options, K_SECONDS(1));
}

int Send(const device* can, const std::array<std::uint8_t, PayloadSize>& payload,
	 std::uint16_t dataId, std::uint16_t fcId)
{
	isotp_msg_id txAddr{};
	isotp_msg_id rxAddr{};
	txAddr.std_id = dataId;
	rxAddr.std_id = fcId;
	return isotp_send(&SendCtx, can, payload.data(), payload.size(), &txAddr, &rxAddr,
		   nullptr, nullptr);
}
}

int main()
{
	const device* can = DEVICE_DT_GET(DT_NODELABEL(can1));
	if (!device_is_ready(can)) {
		LOG_ERR("CAN1 device is not ready");
		return 1;
	}
	int ret = can_set_mode(can, CAN_MODE_NORMAL);
	if (ret == 0) {
		ret = can_start(can);
	}
	if (ret != 0 && ret != -EALREADY) {
		LOG_ERR("Failed to start CAN1 in normal mode: %d", ret);
		return 1;
	}

#if defined(B2B_TEST_ROLE_TX)
	ret = Bind(&ResponseRecvCtx, can, ResponseDataId, ResponseFcId);
#else
	ret = Bind(&RequestRecvCtx, can, RequestDataId, RequestFcId);
#endif
	if (ret != 0) {
		LOG_ERR("ISO-TP bind failed: %d", ret);
		return 1;
	}
	LOG_INF("CAN1 normal mode ready, role=%s, payload=%u bytes",
#if defined(B2B_TEST_ROLE_TX)
		"tx",
#else
		"rx",
#endif
		static_cast<unsigned int>(PayloadSize));

#if defined(B2B_TEST_ROLE_TX)
	k_sleep(K_SECONDS(2));
	const auto request = MakePayload(0x40U);
	ret = Send(can, request, RequestDataId, RequestFcId);
	const bool sent = ret == ISOTP_N_OK;
	if (!sent) {
		LOG_ERR("ISO-TP request send failed: %d", ret);
	}
	const bool received = sent && ReceiveAndCheck(&ResponseRecvCtx, MakePayload(0x60U));
	const bool passed = sent && received;
	isotp_unbind(&ResponseRecvCtx);
#else
	const bool received = ReceiveAndCheck(&RequestRecvCtx, MakePayload(0x40U));
	bool passed = received;
	if (received) {
		ret = Send(can, MakePayload(0x60U), ResponseDataId, ResponseFcId);
		passed = ret == ISOTP_N_OK;
		if (!passed) {
			LOG_ERR("ISO-TP response send failed: %d", ret);
		}
	}
	isotp_unbind(&RequestRecvCtx);
#endif
	LOG_INF("RAW ISO-TP SUMMARY: %s", passed ? "PASS" : "FAIL");
	return passed ? 0 : 1;
}
```

## src/raw_loopback.cpp
```c
#include <cstddef>
#include <cstdint>
#include <zephyr/canbus/isotp.h>
#include <zephyr/kernel.h>
#include <zephyr/logging/log.h>

LOG_MODULE_REGISTER(b2b_down_isotp_loopback, LOG_LEVEL_INF);

namespace
{
isotp_recv_ctx RecvCtx{};
isotp_recv_ctx ReverseRecvCtx{};
isotp_send_ctx SendCtx{};

bool RunCase(const device* can, const char* name, std::size_t length, std::uint8_t flags,
             std::uint8_t blockSize, bool reverseBound, bool separateFc, bool useNet)
{
	RecvCtx = {};
	ReverseRecvCtx = {};
	SendCtx = {};
	const isotp_msg_id dataAddr{.std_id = 0x31, .flags = flags};
	const isotp_msg_id reverseAddr{.std_id = 0x30, .flags = flags};
	isotp_msg_id fcAddr = reverseAddr;
	if (separateFc) {
		fcAddr.std_id = 0x130;
	}
	const isotp_fc_opts opts{.bs = blockSize, .stmin = 5};
	int ret = isotp_bind(&RecvCtx, can, &dataAddr, &fcAddr, &opts, K_SECONDS(1));
	if (ret != 0) {
		LOG_ERR("%s: bind=%d", name, ret);
		return false;
	}
	if (reverseBound) {
		ret = isotp_bind(&ReverseRecvCtx, can, &reverseAddr, &dataAddr, &opts, K_SECONDS(1));
		if (ret != 0) {
			LOG_ERR("%s: reverse bind=%d", name, ret);
			isotp_unbind(&RecvCtx);
			return false;
		}
	}
	std::uint8_t payload[32]{};
	std::uint8_t received[32]{};
	for (std::size_t i = 0; i < length; ++i) {
		payload[i] = static_cast<std::uint8_t>(i + 0x40);
	}
	// All test messages fit in the RX pool and can be drained after synchronous send.
	ret = isotp_send(&SendCtx, can, payload, length, &dataAddr, &fcAddr, nullptr, nullptr);
	const int sendResult = ret;
	bool valid = ret == 0;
	std::size_t total = 0;
	while (valid && total < length) {
		if (useNet) {
			net_buf* buffer = nullptr;
			ret = isotp_recv_net(&RecvCtx, &buffer, K_SECONDS(2));
			if (ret < 0) {
				valid = false;
				break;
			}
			const auto chunk = net_buf_frags_len(buffer);
			const auto copied = net_buf_linearize(received + total, length - total, buffer, 0, chunk);
			LOG_INF("%s: chunk=%u remaining=%d", name, static_cast<unsigned int>(chunk), ret);
			net_buf_unref(buffer);
			total += copied;
			valid = copied == chunk && total <= length && static_cast<std::size_t>(ret) == length - total;
			if (ret == 0) {
				break;
			}
		} else {
			ret = isotp_recv(&RecvCtx, received + total, length - total, K_SECONDS(2));
			LOG_INF("%s: recv chunk=%d", name, ret);
			if (ret <= 0) {
				valid = false;
				break;
			}
			total += static_cast<std::size_t>(ret);
		}
	}
	valid = valid && total == length;
	for (std::size_t i = 0; valid && i < length; ++i) {
		valid = received[i] == payload[i];
	}
	const bool expectTimeout = reverseBound && !separateFc && length > 7;
	const bool passed = expectTimeout ? sendResult == ISOTP_N_TIMEOUT_BS : valid;
	LOG_INF("%s: send=%d bytes=%u/%u %s%s", name, sendResult,
		static_cast<unsigned int>(total), static_cast<unsigned int>(length),
		passed ? "PASS" : "FAIL", expectTimeout ? " (expected FC timeout)" : "");
	// Allow timeout work to finish before reusing the contexts in the next case.
	k_sleep(K_MSEC(100));
	if (reverseBound) {
		isotp_unbind(&ReverseRecvCtx);
	}
	isotp_unbind(&RecvCtx);
	return passed;
}
}

int main()
{
	const auto* can = DEVICE_DT_GET(DT_NODELABEL(can1));
	if (!device_is_ready(can)) {
		LOG_ERR("CAN device is not ready");
		return 0;
	}
	int ret = can_set_mode(can, CAN_MODE_LOOPBACK);
	if (ret != 0) {
		LOG_ERR("can_set_mode failed: %d", ret);
		return 0;
	}
	ret = can_start(can);
	if (ret != 0) {
		LOG_ERR("can_start failed: %d", ret);
		return 0;
	}
	// Delay lets the host attach RTT before diagnostics fill its ring buffer.
	k_sleep(K_SECONDS(2));
	unsigned int passed = 0;
	passed += RunCase(can, "normal-single", 4, 0, 8, false, false, false);
	passed += RunCase(can, "extended-multi", 32, ISOTP_MSG_EXT_ADDR, 8, false, false, false);
	passed += RunCase(can, "normal-multi", 32, 0, 8, false, false, false);
	passed += RunCase(can, "extended-bs0", 32, ISOTP_MSG_EXT_ADDR, 0, false, false, false);
	passed += RunCase(can, "overlap-extended", 14, ISOTP_MSG_EXT_ADDR, 8, true, false, false);
	passed += RunCase(can, "overlap-normal", 14, 0, 8, true, false, false);
	passed += RunCase(can, "separate-fc-extended", 14, ISOTP_MSG_EXT_ADDR, 8, true, true, true);
	passed += RunCase(can, "separate-fc-normal", 32, 0, 8, true, true, true);
	LOG_INF("RAW LOOPBACK SUMMARY: %u/8 cases matched expectations", passed);
	return 0;
}
```
