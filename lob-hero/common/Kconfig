## lob-hero/common/Kconfig
```kconfig
# Copyright (c) 2025 RobotPilots-SZU
# SPDX-License-Identifier: Apache-2.0

menuconfig POC_COMMON
	bool "Breeze poc common modules"
	help
	  Common module for poc to reuse, making it easier to port to breeze-modules.
```

## lob-hero/test/common/testcase.yaml
```yaml
tests:
  lob_hero.common:
    platform_allow:
      - native_sim/native/64
    tags:
      - common
```

## west.yml
```yaml
manifest:
  self:
    path: .
    import:
      file: dependencies.yml
      path-prefix: externals
```
